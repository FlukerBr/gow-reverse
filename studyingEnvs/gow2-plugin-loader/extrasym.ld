PROVIDE(DAT_35D744 = 0x0035D744);
PROVIDE(DAT_35D748 = 0x0035D748);
PROVIDE(DAT_35D74C = 0x0035D74C);
PROVIDE(DAT_35D750 = 0x0035D750);
PROVIDE(DAT_35D754 = 0x0035D754);
PROVIDE(DAT_35D758 = 0x0035D758);